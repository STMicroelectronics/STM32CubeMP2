// SPDX-License-Identifier: (GPL-2.0-only OR BSD-3-Clause)
/*
 * Copyright (C) STMicroelectronics 2024 - All Rights Reserved
 */

/dts-v1/;

#include "stm32mp257f-ev1.dts"

&clk_hse {
	st,css;
};

&clk_lse {
	st,css;
};

&tamp {
	st,tamp-internal-tampers =
		<INT_TAMPER_BKUP_DOMAIN_THRESHOLD TAMPER_CONFIRMED_MODE>,
		<INT_TAMPER_TEMPERATURE_MONITORING TAMPER_CONFIRMED_MODE>,
		<INT_TAMPER_LSE_MONITORING TAMPER_POTENTIAL_MODE>,
		<INT_TAMPER_HSE_MONITORING TAMPER_POTENTIAL_MODE>,
		<INT_TAMPER_RTC_CALENDAR_OVERFLOW TAMPER_CONFIRMED_MODE>,
		<INT_TAMPER_MONOTONIC_COUNTER_1 TAMPER_CONFIRMED_MODE>,
		<INT_TAMPER_CRYPTO_PERIPH_FAULT TAMPER_CONFIRMED_MODE>,
		<INT_TAMPER_MONOTONIC_COUNTER_2 TAMPER_CONFIRMED_MODE>,
		<INT_TAMPER_IWDG3_RESET TAMPER_POTENTIAL_MODE>,
		<INT_TAMPER_IWDG5_RESET TAMPER_POTENTIAL_MODE>,
		<INT_TAMPER_IWDG1_RESET TAMPER_POTENTIAL_MODE>,
		<INT_TAMPER_JTAG_SWD_ACCESS TAMPER_CONFIRMED_MODE>;
};
