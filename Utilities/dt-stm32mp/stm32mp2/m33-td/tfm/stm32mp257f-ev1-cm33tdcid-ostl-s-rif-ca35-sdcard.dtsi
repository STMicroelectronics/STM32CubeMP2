// SPDX-License-Identifier: (GPL-2.0-only OR BSD-3-Clause)
/*
 * Copyright (C) STMicroelectronics 2024 - All Rights Reserved
 * Author: Loic Pallardy loic.pallardy@foss.st.com for STMicroelectronics.
 */

/*
 * stm32mp257f device tree configuration
 * Project : ostl
 * Generated by XLmx tool version 2.8 - 2/28/2025 4:09:30 PM
 */

&a35_rproc {
	access-controllers = <&rifsc RIFPROT(STM32MP25_RIFSC_PKA_ID, RIF_CID1_BF, RIF_LOCK, RIF_SEC, RIF_PRIV, RIF_UNUSED, RIF_SEM_EN, RIF_CFEN)>,
		<&rifsc RIFPROT(STM32MP25_RIFSC_SAES_ID, RIF_CID1_BF, RIF_LOCK, RIF_SEC, RIF_PRIV, RIF_UNUSED, RIF_SEM_EN, RIF_CFEN)>,
		<&rifsc RIFPROT(STM32MP25_RIFSC_HASH_ID, RIF_CID1_BF, RIF_LOCK, RIF_SEC, RIF_PRIV, RIF_UNUSED, RIF_SEM_EN, RIF_CFEN)>,
		<&rifsc RIFPROT(STM32MP25_RIFSC_RNG_ID, RIF_CID1_BF, RIF_LOCK, RIF_SEC, RIF_PRIV, RIF_UNUSED, RIF_SEM_EN, RIF_CFEN)>,
		<&rifsc RIFPROT(STM32MP25_RIFSC_CRYP1_ID, RIF_CID1_BF, RIF_LOCK, RIF_SEC, RIF_PRIV, RIF_UNUSED, RIF_SEM_EN, RIF_CFEN)>,
		<&pwr RIFPROT(RIF_PWR_RESOURCE(6), RIF_UNUSED, RIF_UNLOCK, RIF_SEC, RIF_PRIV, RIF_CID1, RIF_SEM_DIS, RIF_CFEN)>,
		<&rcc_rif RIFPROT(RIF_RCC_RESOURCE(RES_FLEX51), RIF_UNUSED, RIF_UNLOCK, RIF_NSEC, RIF_PRIV, RIF_CID1, RIF_SEM_DIS, RIF_CFEN)>,
		<&rcc_rif RIFPROT(RIF_RCC_RESOURCE(103), RIF_CID1_BF, RIF_LOCK, RIF_SEC, RIF_PRIV, RIF_UNUSED, RIF_SEM_EN, RIF_CFEN)>;
};

&bsec {
	access-controllers = <&rcc_rif RIFPROT(RIF_RCC_RESOURCE(103), RIF_CID1_BF|RIF_CID2_BF, RIF_LOCK, RIF_SEC, RIF_PRIV, RIF_UNUSED, RIF_SEM_EN, RIF_CFEN)>;
};

&rng {
       access-controllers = <&rifsc RIFPROT(STM32MP25_RIFSC_RNG_ID, RIF_CID1_BF|RIF_CID2_BF, RIF_LOCK, RIF_SEC, RIF_PRIV, RIF_UNUSED, RIF_SEM_EN, RIF_CFEN)>;
};
