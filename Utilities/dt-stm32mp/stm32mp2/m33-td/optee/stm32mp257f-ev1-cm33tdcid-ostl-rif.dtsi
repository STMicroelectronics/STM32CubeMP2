// SPDX-License-Identifier: (GPL-2.0-only OR BSD-3-Clause)
/*
 * Copyright (C) STMicroelectronics 2022 - All Rights Reserved
 * Author: Loic Pallardy loic.pallardy@foss.st.com for STMicroelectronics.
 */

/*
 * stm32mp257f device tree configuration
 * Project : ostl
 * Generated by XLmx tool version 2.7 - 10/28/2024 12:14:24 PM
 */

&tfa_bl31 {
	st,protreg = <RISABPROT(RIF_DDCID_EN, RIF_CID1, RIF_SEC, RIF_NPRIV, RIF_CFEN, RIF_CID1_BF, RIF_CID1_BF, RIF_CID1_BF)>;
};

&hpdma_lli {
	st,protreg = <RISABPROT(RIF_DDCID_EN, RIF_CID1, RIF_NSEC, RIF_NPRIV, RIF_CFEN, RIF_CID1_BF, RIF_CID1_BF, RIF_CID1_BF)>;
};

&risab1 {
	memory-region = <&tfa_bl31>;
};

&risab2 {
	memory-region = <&hpdma_lli>;
};

